## Kconfig
```
# Parametry aplikacji sterowane build-time (-DCONFIG_...=<wartosc>).
#
# Pola serii w board-power-test (zakladka Zigbee) odpowiadaja tym symbolom:
#
#   Send interval (T)    -> CONFIG_ZB_SEND_INTERVAL_S
#   Long-poll interval   -> CONFIG_ZB_POLL_INTERVAL_S
#
# Keepalive zostaje na stale w kodzie (60 s, main.c), wiec nie ma go tutaj.
#
# Wartosci domyslne = dzisiejsze zachowanie kodu, wiec build bez zadnej
# flagi daje ten sam obraz co dotad.

config ZB_SEND_INTERVAL_S
	int "Send interval T - co ile sekund wysylamy raport [s]"
	default 20
	range 1 4200
	help
	  Okres wysylania ZCL Report Attribute do koordynatora. To jest "T"
	  z modelu I_avg(T) = E_report/T + I_sleep.

	  Gorny limit 4200 s wynika z ZB_MILLISECONDS_TO_BEACON_INTERVAL:
	  makro mnozy ms x 1000 w 32-bitowym zb_time_t, wiec ok. 4294 s to
	  granica przepelnienia.

config ZB_POLL_INTERVAL_S
	int "Long-poll interval - co ile ED odpytuje rodzica [s]"
	default 3600
	range 1 4200
	help
	  macDataPollInterval: co tyle sekund radio budzi sie, zeby zapytac
	  rodzica o zalegle wiadomosci. Kazde takie wybudzenie kosztuje prad,
	  nawet gdy nie ma zadnych danych do odebrania.

source "Kconfig.zephyr"
```

## sysbuild.conf
```
# ncs-zigbee's ZBOSS NVRAM backend (subsys/osif/zb_nrf_nvram.c) includes
# <pm_config.h> and uses PM_ZBOSS_NVRAM_ID, which only exist when the NCS
# Partition Manager runs. Partition Manager defaults to 'n' in NCS v3.4, so it
# has to be requested explicitly here (it registers pm.yml.zboss, which defines
# the ZBOSS_NVRAM and ZBOSS_PRODUCT_CONFIG partitions).
SB_CONFIG_PARTITION_MANAGER=y
```

## prj.conf
```kconfig
CONFIG_ZIGBEE_ROLE_END_DEVICE=y
CONFIG_ZIGBEE_ADD_ON=y
CONFIG_ZIGBEE_APP_UTILS=y

# Low power
# CONFIG_PM nie jest dostępne dla nRF54L15 (SoC nie robi "select HAS_PM" w NCS v3.4)
# CONFIG_PM=y
CONFIG_LOG=n
CONFIG_PM_DEVICE=y
CONFIG_PM_DEVICE_RUNTIME=y          # i2c30 ma zephyr,pm-device-runtime-auto
CONFIG_RAM_POWER_DOWN_LIBRARY=y
CONFIG_SERIAL=n

# Logowanie przez SEGGER RTT (UART wyłączony)
CONFIG_LOG_MODE_IMMEDIATE=n
CONFIG_USE_SEGGER_RTT=n
CONFIG_LOG_BACKEND_RTT=n
CONFIG_LOG_BACKEND_UART=n
CONFIG_CONSOLE=n
CONFIG_RTT_CONSOLE=n
CONFIG_UART_CONSOLE=n

# Czujniki
CONFIG_I2C=n
CONFIG_SENSOR=n
# BMI270 nieużywany w tej aplikacji
CONFIG_BMI270=n
CONFIG_BMI270_TRIGGER_GLOBAL_THREAD=n

# Regulator szyny czujnikón
CONFIG_REGULATOR=n
CONFIG_REGULATOR_FIXED=n

# NRF_PLATFORM_LUMOS jest ustawiane przez NCS dla każdego nRF54L i jest deprecated;
# bez tego ostrzeżenie deprecacji przerywa konfigurację
CONFIG_WARN_DEPRECATED=n

CONFIG_NET_IPV6=n
CONFIG_NET_IP_ADDR_CHECK=n
CONFIG_NET_UDP=n

# do pomiarów prądu — patrz snippet low_power w samplu light_switch
```

## app.overlay
```dts
#include <zephyr/dt-bindings/gpio/gpio.h>

/*
 * P0.00 bramkuje szyne zasilania czujnikow (STS4x/BMI270/LTR329) przez load
 * switch. Plyta deklaruje to wejscie jako aktywne stanem NISKIM:
 *
 *   sensor_pwr: enable-gpios = <&gpio0 0 GPIO_ACTIVE_LOW>;  (regulator-boot-on)
 *
 * czyli stan niski = szyna WLACZONA. Poprzednia wersja tego pliku wymuszala
 * output-low, wiec faktycznie zasilala czujniki i ich pull-upy I2C - stad staly
 * pobor rzedu ~140 uA. Wymuszamy stan WYSOKI, zeby szyne wylaczyc.
 *
 * Ta aplikacja nie uzywa czujnikow i buduje sie z CONFIG_REGULATOR_FIXED=n,
 * wiec bez hoga nikt tym pinem nie steruje - wejscie enable wisi w powietrzu.
 *
 * UWAGA - konflikt do rozstrzygniecia ze schematem: gpio0 ma na nRF54L15 tylko
 * 5 pinow (ngpios = <5>), a P0.00/P0.01 to piny XL1/XL2 kwarcu 32.768 kHz,
 * ktory plyta konfiguruje przez &lfxo. Jesli kwarc jest obsadzony, sterowanie
 * P0.00 jako GPIO blokuje jego start. Dlatego prj.conf wymusza
 * CONFIG_CLOCK_CONTROL_NRF_K32SRC_RC=y - LFCLK nie potrzebuje wtedy kwarcu i
 * hog na P0.00 jest bezpieczny.
 */
&gpio0 {
	sensor_pwr_off_hog {
		gpio-hog;
		gpios = <0 GPIO_ACTIVE_HIGH>;
		output-high;
	};
};

/* Zeby ewentualne wlaczenie CONFIG_REGULATOR_FIXED=y nie bilo sie z hogiem o P0.00. */
&sensor_pwr {
	status = "disabled";
};
```

## src/main.c
```c
#include <zboss_api.h> // the Zigbee stack itself (ZBOSS) - joining network, sending packets, etc.
#include <zephyr/kernel.h>  // Zephyr RTOS - gives you k_sleep, threads, etc.
#include "zb_sensor_node.h"
#include <zboss_api_addons.h> // extra helper macros/functions on top of zboss_api.h
#include <zephyr/logging/log.h>
// #include <zephyr/drivers/gpio.h>
#include <zigbee/zigbee_app_utils.h> // Nordic's helper functions (zigbee_enable, sleepy behavior, etc.)
#include <zigbee/zigbee_error_handler.h> // ZB_ERROR_CHECK macro
#include <zb_nrf_platform.h> // zigbee_enable()
#include <ram_pwrdn.h>

LOG_MODULE_REGISTER(btz, LOG_LEVEL_INF);

#define LIGHT_BULB_ENDPOINT 10
// #define LED_NODE DT_ALIAS(led0)

#define COORDINATOR_SHORT_ADDR 0x0000
#define COORDINATOR_EP 10
zb_uint16_t coord_short_addr = COORDINATOR_SHORT_ADDR; /* coordinator address we need for communication */

// static const struct gpio_dt_spec led = GPIO_DT_SPEC_GET(LED_NODE, gpios);

struct zb_device_ctx{
    zb_zcl_basic_attrs_ext_t basic_attr;
    zb_zcl_identify_attrs_t identify_attr;
    zb_zcl_on_off_attrs_t on_off_attr;
};

static struct zb_device_ctx dev_ctx;

static void app_clusters_attr_init(void){
    dev_ctx.basic_attr.zcl_version = ZB_ZCL_VERSION;
    dev_ctx.basic_attr.power_source =  ZB_ZCL_BASIC_POWER_SOURCE_BATTERY;
    dev_ctx.identify_attr.identify_time = ZB_ZCL_IDENTIFY_IDENTIFY_TIME_DEFAULT_VALUE;
    dev_ctx.on_off_attr.on_off = ZB_FALSE;
}

/* attribute lists*/
ZB_ZCL_DECLARE_BASIC_ATTRIB_LIST(basic_attrib_list, &dev_ctx.basic_attr.zcl_version, &dev_ctx.basic_attr.power_source);
ZB_ZCL_DECLARE_IDENTIFY_ATTRIB_LIST(identify_attr_list,&dev_ctx.identify_attr.identify_time);
ZB_ZCL_DECLARE_ON_OFF_ATTRIB_LIST(on_off_attr_list, &dev_ctx.on_off_attr.on_off);

/* cluster lists */
ZB_DECLARE_LIGHT_BULB_CLUSTER_LIST(light_bulb_clusters, basic_attrib_list, identify_attr_list, on_off_attr_list);

/* endpoint */
ZB_DECLARE_LIGHT_BULB_EP(light_bulb_ep, LIGHT_BULB_ENDPOINT, light_bulb_clusters);

/* device context */
ZBOSS_DECLARE_DEVICE_CTX_1_EP(light_bulb_ctx, light_bulb_ep);

// static void on_off_set_value(zb_bool_t value){
//     dev_ctx.on_off_attr.on_off = value;
//     if(value){
//         LOG_INF("LED IS OFF!");
//         gpio_pin_set_dt(&led, 1);
//     }
//     else{
//         LOG_INF("LED IS ON!");
//         gpio_pin_set_dt(&led, 0);
//     }
// }

static zb_uint8_t zcl_device_cb(zb_bufid_t bufid){
    zb_zcl_device_callback_param_t *p = ZB_BUF_GET_PARAM(bufid, zb_zcl_device_callback_param_t); /* returns a pointer to the data in the buffer */
    p->status = RET_OK;

    if(p->device_cb_id != ZB_ZCL_SET_ATTR_VALUE_CB_ID){
        return ZB_FALSE;
    }

    // zb_uint16_t cluster_id = p->cb_param.set_attr_value_param.cluster_id;
    // zb_uint16_t attr_id = p->cb_param.set_attr_value_param.attr_id;

    // if(cluster_id == ZB_ZCL_CLUSTER_ID_ON_OFF && attr_id == ZB_ZCL_ATTR_ON_OFF_ON_OFF_ID){
    //     zb_uint8_t value = p->cb_param.set_attr_value_param.values.data8;
    //     if(value){
    //         on_off_set_value(ZB_TRUE);
    //     }
    //     else{
    //         on_off_set_value(ZB_FALSE);
    //     }
    // }
    return ZB_FALSE;
}

void zboss_signal_handler(zb_bufid_t bufid){
    zb_zdo_app_signal_hdr_t *sg_p  = NULL;
    zb_zdo_app_signal_type_t  sig  = zb_get_app_signal(bufid, &sg_p);
    zb_ret_t status = ZB_GET_APP_SIGNAL_STATUS(bufid);

    switch(sig){
        case ZB_BDB_SIGNAL_DEVICE_FIRST_START:
            LOG_INF("Joining network for the first time...");
            bdb_start_top_level_commissioning(ZB_BDB_NETWORK_STEERING);
            break;

        case ZB_BDB_SIGNAL_DEVICE_REBOOT:
            zb_zdo_pim_set_long_poll_interval(CONFIG_ZB_POLL_INTERVAL_S * 1000);
            bdb_start_top_level_commissioning(ZB_BDB_NETWORK_STEERING);
            break;

        case ZB_BDB_SIGNAL_STEERING:
            if(status == RET_OK){
                zb_zdo_pim_set_long_poll_interval(CONFIG_ZB_POLL_INTERVAL_S * 1000);
                uint16_t panId = zb_get_pan_id();
                uint8_t channel = zb_get_current_channel();
                uint16_t shortAddr = zb_get_short_address();

                LOG_INF("Joined a network: PAN ID=0x%04X, Channel=%u, Short Addr=0x%04X", panId, channel, shortAddr);
            }
            else{
                /* ZB network unit of time is BI(beacon interval), ZB devices use it to schedule operations. Beacons because zb in built on ieee802.15.4 which measures time in beacon intervals */
                ZB_SCHEDULE_APP_ALARM((zb_callback_t)bdb_start_top_level_commissioning, ZB_BDB_NETWORK_STEERING, ZB_MILLISECONDS_TO_BEACON_INTERVAL(1000)); /* after delay call this function */
            }
            break;

        /* if an end device leaves the zigbee network */
        case ZB_ZDO_SIGNAL_LEAVE:
            LOG_INF("Reconnecting the network...");
            ZB_SCHEDULE_APP_ALARM((zb_callback_t)bdb_start_top_level_commissioning, ZB_BDB_NETWORK_STEERING, ZB_MILLISECONDS_TO_BEACON_INTERVAL(1000)); /* after delay call this function */
            break;

        default:
            ZB_ERROR_CHECK(zigbee_default_signal_handler(bufid));
            break;
    }
    if (bufid) {
        zb_buf_free(bufid);
    }
}

/* builds and sends the frame directly and schedule it in the loop via alarm */
static void send_test_report(zb_uint8_t param)
{
    zb_bufid_t bufid = zb_buf_get_out(); /* free memory buffer */
    if (!bufid) {
        LOG_ERR("No buffer available");
        ZB_SCHEDULE_APP_ALARM(send_test_report, 0, ZB_MILLISECONDS_TO_BEACON_INTERVAL(60000));
        return;
    }

    zb_uint8_t *ptr = ZB_ZCL_START_PACKET(bufid); /* write into that buffer */
    ZB_ZCL_CONSTRUCT_GENERAL_COMMAND_REQ_FRAME_CONTROL_A(ptr, ZB_ZCL_FRAME_DIRECTION_TO_CLI, ZB_ZCL_NOT_MANUFACTURER_SPECIFIC, ZB_ZCL_DISABLE_DEFAULT_RESPONSE); /* writes control byte */
    ZB_ZCL_CONSTRUCT_COMMAND_HEADER(ptr, ZB_ZCL_GET_SEQ_NUM(), ZB_ZCL_CMD_REPORT_ATTRIB); /* the following header bytes, frame is a report attribute cmd */

    zb_uint8_t test_value = ZB_TRUE; /* the const test value */

    ZB_ZCL_PACKET_PUT_DATA16_VAL(ptr, ZB_ZCL_ATTR_ON_OFF_ON_OFF_ID); /* which attribute */
    ZB_ZCL_PACKET_PUT_DATA8(ptr, ZB_ZCL_ATTR_TYPE_BOOL); /* what data type */
    ZB_ZCL_PACKET_PUT_DATA8(ptr, test_value); /* the actual value */

    ZB_ZCL_SEND_COMMAND_SHORT_WITHOUT_ACK(bufid, ptr, coord_short_addr, ZB_APS_ADDR_MODE_16_ENDP_PRESENT, COORDINATOR_EP, LIGHT_BULB_ENDPOINT, ZB_AF_HA_PROFILE_ID, ZB_ZCL_CLUSTER_ID_ON_OFF, NULL, 0);
    LOG_INF("Sent test report"); /* locally we see that frame was sent */
    ZB_SCHEDULE_APP_ALARM(send_test_report, 0, ZB_MILLISECONDS_TO_BEACON_INTERVAL(CONFIG_ZB_SEND_INTERVAL_S * 1000)); /* repeats every CONFIG_ZB_SEND_INTERVAL_S seconds (default 20) */
}

int main(void){
    LOG_INF("Starting Zigbee Light Bulb (Sleepy End Device)");
    // gpio_pin_configure_dt(&led, GPIO_OUTPUT_INACTIVE); /* configure led gpio as output*/
    
    ZB_ZCL_REGISTER_DEVICE_CB((zb_callback_t)zcl_device_cb); /* tell zboss which function ahould be called as an event handler callback */
    ZB_AF_REGISTER_DEVICE_CTX(&light_bulb_ctx); /* register device context */
    app_clusters_attr_init(); /* attribute init function */
    
    zb_set_ed_timeout(ED_AGING_TIMEOUT_256MIN); /* set end device waiting timeout - if no reaction for 256 minutes -> end device is dead */
    // keepalive timeout should be ≥ poll interval.
    zb_set_keepalive_timeout(ZB_MILLISECONDS_TO_BEACON_INTERVAL(3600000)); /* 60 min - how often the end device tells its parent "I'm still here" */
    zigbee_configure_sleepy_behavior(true); /* enable sleepy behavoir */

    if (IS_ENABLED(CONFIG_RAM_POWER_DOWN_LIBRARY)) {
        power_down_unused_ram();
    }

    zb_zdo_pim_set_long_poll_interval(CONFIG_ZB_POLL_INTERVAL_S * 1000); /* how often an end device wakes up to poll a parent about a new message (default 30 s) */
    zigbee_enable(); /* enable zigbee */
    
    ZB_SCHEDULE_APP_ALARM(send_test_report, 0, ZB_MILLISECONDS_TO_BEACON_INTERVAL(1000));
    k_sleep(K_FOREVER); /* sleep forever*/
    return 0;
}
```

## src/zb_sensor_node.h
```c
#define ZB_LIGHT_BULB_DEVICE_ID 0x0100    /* hue app: it's an On/Off Light */

#define ZB_DEVICE_VER_LIGHT_BULB 0

#define ZB_LIGHT_BULB_IN_CLUSTER_NUM 3    /* server: Basic + Identify + On/Off clusters */
#define ZB_LIGHT_BULB_OUT_CLUSTER_NUM 0   /* no out clusters - cluster where you're the client */

/* macro that builds the cluster list */
#define ZB_DECLARE_LIGHT_BULB_CLUSTER_LIST(                      \
    cluster_list_name,                                           \
    basic_attr_list,                                             \
    identify_attr_list,                                          \
    on_off_attr_list                                             \
)zb_zcl_cluster_desc_t cluster_list_name[] =                     \
{                                                                \
    ZB_ZCL_CLUSTER_DESC(                                         \
        ZB_ZCL_CLUSTER_ID_IDENTIFY,                              \
        ZB_ZCL_ARRAY_SIZE(identify_attr_list, zb_zcl_attr_t),    \
        (identify_attr_list),                                    \
        ZB_ZCL_CLUSTER_SERVER_ROLE,                              \
        ZB_ZCL_MANUF_CODE_INVALID                                \
    ),                                                           \
    ZB_ZCL_CLUSTER_DESC(                                         \
        ZB_ZCL_CLUSTER_ID_BASIC,                                 \
        ZB_ZCL_ARRAY_SIZE(basic_attr_list, zb_zcl_attr_t),       \
        (basic_attr_list),                                       \
        ZB_ZCL_CLUSTER_SERVER_ROLE,                              \
        ZB_ZCL_MANUF_CODE_INVALID                                \
    ),                                                           \
    ZB_ZCL_CLUSTER_DESC(                                         \
        ZB_ZCL_CLUSTER_ID_ON_OFF,                                \
        ZB_ZCL_ARRAY_SIZE(on_off_attr_list, zb_zcl_attr_t),      \
        (on_off_attr_list),                                      \
        ZB_ZCL_CLUSTER_SERVER_ROLE,                              \
        ZB_ZCL_MANUF_CODE_INVALID                                \
    )                                                            \
}
/* the result of calling ZB_DECLARE_LIGHT_BULB_CLUSTER_LIST(name, cl1, cl2, cl3) is an array zb_zcl_cluster_desc_t name = {cl1, cl2, cl3} */

ZB_DECLARE_SIMPLE_DESC(3, 0); /* 3 cluster description in one array (basic, identify, on/off)*/

/* ## is a token, macro that generates a type, ## glues two pieces of text together into one identifier */
/* creates a variable to preserve endpoint number, device type, list of clusters */
#define ZB_ZCL_DECLARE_LIGHT_BULB_SIMPLE_DESC(ep_name, ep_id, in_clust_num, out_clust_num) \
					       \
	ZB_AF_SIMPLE_DESC_TYPE(in_clust_num, out_clust_num) simple_desc_##ep_name =	       \
	{										       \
		ep_id,									       \
		ZB_AF_HA_PROFILE_ID,							       \
		ZB_LIGHT_BULB_DEVICE_ID,						       \
		ZB_DEVICE_VER_LIGHT_BULB,						       \
		0,									       \
		in_clust_num,								       \
		out_clust_num,								       \
		         {                                               \
            ZB_ZCL_CLUSTER_ID_BASIC,                    \
            ZB_ZCL_CLUSTER_ID_IDENTIFY,                 \
            ZB_ZCL_CLUSTER_ID_ON_OFF                    \
        }                                               \
    }

/* where ZB_ZCL_DECLARE_LIGHT_BULB_SIMPLE_DESC creates a varibale that has (endpoint number, device type, cluster ID list) */
/* ZB_AF_DECLARE_ENDPOINT_DESC(...) creates a big description of the endpoint */
#define ZB_DECLARE_LIGHT_BULB_EP(ep_name, ep_id, cluster_list)		      \
	ZB_ZCL_DECLARE_LIGHT_BULB_SIMPLE_DESC(ep_name, ep_id,		      \
		ZB_LIGHT_BULB_IN_CLUSTER_NUM, ZB_LIGHT_BULB_OUT_CLUSTER_NUM); \
		ZB_AF_DECLARE_ENDPOINT_DESC(ep_name, ep_id, ZB_AF_HA_PROFILE_ID, 0, NULL,     \
		ZB_ZCL_ARRAY_SIZE(cluster_list, zb_zcl_cluster_desc_t), cluster_list, \
			(zb_af_simple_desc_1_1_t *)&simple_desc_##ep_name, \
0, NULL, /* No reporting ctx */ \
0, NULL) 
```
